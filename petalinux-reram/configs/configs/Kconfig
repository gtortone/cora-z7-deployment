## petalinux-reram/configs/configs/Kconfig
```kconfig
mainmenu "PetaLinux System Configuration"
config SUBSYSTEM_TYPE_LINUX
        bool
        default y
        select SYSTEM_ZYNQ

config SYSTEM_ZYNQ
        bool "ZYNQ Configuration"
        help
          ZYNQ Configuration for petalinux project.
          All these config options will be in /home/ubuntu/workshop/devel/Memphys/cora-z7-deployment/Memphys/petalinux/configs/config

config SUBSYSTEM_DISTRO_PETALINUX
        bool
        default y
        help

source /home/ubuntu/workshop/devel/Memphys/cora-z7-deployment/Memphys/petalinux/configs/configs/Kconfig.main
```

## petalinux-reram/configs/configs/Kconfig.main
```kconfig
# Copyright (C) 2021-2022, Xilinx, Inc.  All rights reserved.
# Copyright (C) 2022-2023, Advanced Micro Devices, Inc.  All rights reserved.
#
# SPDX-License-Identifier: MIT
#

choice
	prompt "Subsystem Architecture (NO EDIT!)"
	default SUBSYSTEM_ARCH_ARM
	help
	  This option is to control the processor targeted by PetaLinux.
	  WARNING: Do not edit this option.

config SUBSYSTEM_ARCH_AARCH64
	bool "aarch64"
	help
	  Choose this option to specify AARCH64 as the SUBSYSTEM architecture

config SUBSYSTEM_ARCH_ARM
	bool "arm"
	help
	  Choose this option to specify ARM as the SUBSYSTEM architecture

config SUBSYSTEM_ARCH_MICROBLAZE
	bool "microblaze"
	help
	  Choose this option to specify MicroBlaze as the SUBSYSTEM architecture
endchoice

config SUBSYSTEM_ENDIAN_LITTLE
	bool
	default y

if SUBSYSTEM_DISTRO_PETALINUX

source /home/ubuntu/workshop/devel/Memphys/cora-z7-deployment/Memphys/petalinux/configs/configs/Kconfig.linuxcompselection

source /home/ubuntu/workshop/devel/Memphys/cora-z7-deployment/Memphys/petalinux/configs/configs/Kconfig.autoconfigsettings

endif

source /home/ubuntu/workshop/devel/Memphys/cora-z7-deployment/Memphys/petalinux/configs/configs/Kconfig.syshw

source /home/ubuntu/workshop/devel/Memphys/cora-z7-deployment/Memphys/petalinux/configs/configs/Kconfig.dtgsettings

source /home/ubuntu/workshop/devel/Memphys/cora-z7-deployment/Memphys/petalinux/configs/configs/Kconfig.bootcompconfigurations

if SUBSYSTEM_DISTRO_PETALINUX

source /home/ubuntu/workshop/devel/Memphys/cora-z7-deployment/Memphys/petalinux/configs/configs/Kconfig.imagepkgconfigurations

endif

source /home/ubuntu/workshop/devel/Memphys/cora-z7-deployment/Memphys/petalinux/configs/configs/Kconfig.yoctobuildsettings
```

## petalinux-reram/configs/configs/Kconfig.syshw
```kconfig
menu "Subsystem Hardware Settings"

config SUBSYSTEM_PROCESSOR0_IP_NAME
	string
	default ps7_cortexa9_0

config SUBSYSTEM_ENABLE_ARCHARM
	bool
	default y
	select SUBSYSTEM_ARCH_ARM
	depends on SUBSYSTEM_PROCESSOR_ps7_cortexa9_0_SELECT

choice
	prompt "System Processor"
	help
	Select a processor as the system processor.

config SUBSYSTEM_PROCESSOR_ps7_cortexa9_0_SELECT
	bool "ps7_cortexa9_0"

endchoice

if SUBSYSTEM_PROCESSOR_ps7_cortexa9_0_SELECT

menu "Memory Settings"
choice
	prompt "Primary Memory"
	default SUBSYSTEM_MEMORY_PS7_DDR_0_SELECT

	help
	The configuration in this menu impacts the
	memory settings in the device tree autoconfig files.
	If you select "manual",
	PetaLinux will auto generate memory node based on user inputs,
	you will need to specify base address and memory size.
	To skip generating lower or upper memory node specify 0x0 offset to the memory size.

config SUBSYSTEM_MEMORY_PS7_DDR_0_SELECT
	bool "ps7_ddr_0"

config SUBSYSTEM_MEMORY_MANUAL_SELECT
	bool "manual"

endchoice

config SUBSYSTEM_MEMORY_PS7_DDR_0_BASEADDR
	hex "System memory base address"
	default 0x0
	range 0x0 0x1dffffff
	depends on SUBSYSTEM_MEMORY_PS7_DDR_0_SELECT
	help
	Start address of the system memory.
	It has to be within the selected primary memory physical address range.
	Make sure the DT memory entry should start with provided address.

config SUBSYSTEM_MEMORY_PS7_DDR_0_SIZE
	hex "System memory size"
	default 0x20000000
	range 0x2000000 0x20000000
	depends on SUBSYSTEM_MEMORY_PS7_DDR_0_SELECT
	help
	Size of the system memory. Minimum is 32MB, maximum is the size of
	the selected primary memory physical address range.

config SUBSYSTEM_MEMORY_PS7_DDR_0_U__BOOT_TEXTBASE_OFFSET
	hex "u-boot text base address"
	default 0x8000000 if SUBSYSTEM_ARCH_AARCH64
	default 0x4000000 if SUBSYSTEM_ARCH_ARM
	default 0x100000 if SUBSYSTEM_ARCH_MICROBLAZE
	range 0x100000 0x1e0fffff
	depends on SUBSYSTEM_MEMORY_PS7_DDR_0_SELECT
	depends on !SUBSYSTEM_COMPONENT_U__BOOT_NAME_NONE
	help
	u-boot text base address by specifying from the memory base address.
	u-boot load address = bank base address + offset. And same value will
	pass to TF-A also. Minimum suggested is 1MB.

config SUBSYSTEM_MEMORY_IP_NAME
	string
	default ps7_ddr_0
	depends on SUBSYSTEM_MEMORY_PS7_DDR_0_SELECT

config SUBSYSTEM_MEMORY_MANUAL_LOWER_BASEADDR
	hex "Lower memory base address"
	default 0x0
	depends on SUBSYSTEM_MEMORY_MANUAL_SELECT
	help
	base address of the lower memory
	Make sure the DT memory entry should start with provided address.

config SUBSYSTEM_MEMORY_MANUAL_LOWER_MEMORYSIZE
	hex "Lower memory size"
	default 0x80000000
	depends on SUBSYSTEM_MEMORY_MANUAL_SELECT
	help
	Size of the lower memory. Minimum is 32MB, maximum is the size of
	the selected primary memory physical address range.
	If you specify 0x0 offset then it will skip generating lower memory node.

config SUBSYSTEM_MEMORY_MANUAL_UPPER_BASEADDR
	hex "Upper memory base address"
	default 0x800000000
	depends on SUBSYSTEM_MEMORY_MANUAL_SELECT
	depends on SUBSYSTEM_ARCH_AARCH64
	help
	base address of the upper memory
	Make sure the DT memory entry should start with provided address.

config SUBSYSTEM_MEMORY_MANUAL_UPPER_MEMORYSIZE
	hex "Upper memory size"
	default 0x80000000
	depends on SUBSYSTEM_MEMORY_MANUAL_SELECT
	depends on SUBSYSTEM_ARCH_AARCH64
	help
	Size of the lower memory. Minimum is 32MB, maximum is the size of
	the selected primary memory physical address range.
	If you specify 0x0 offset then it will skip generating lower memory node.

endmenu

menu "Serial Settings"

choice
	prompt "FSBL Serial stdin/stdout"
	help
	Select a serial as the FSBL's stdin,stdout.
	If you select 'manual', you will need to add this variable
	YAML_SERIAL_CONSOLE_STDIN:forcevariable:pn-<recipename> = "<serial_ipname>"
	YAML_SERIAL_CONSOLE_STDOUT:forcevariable:pn-<recipename> = "<serial_ipname>"
	in petalinuxbsp.conf file to specify the stdin/stdout."

config SUBSYSTEM_FSBL_SERIAL_PS7_UART_0_SELECT
	bool "ps7_uart_0"

config SUBSYSTEM_FSBL_SERIAL_PS7_UART_1_SELECT
	bool "ps7_uart_1"

config SUBSYSTEM_FSBL_SERIAL_MANUAL_SELECT
	bool "manual"

endchoice

choice
	prompt "U-boot/Linux Serial stdin/stdout"
	help
	Select a serial as the U-boot and Linux's stdin,stdout.
	If you select 'manual', you will need to add this variable
	YAML_SERIAL_CONSOLE_STDIN:forcevariable:pn-<recipename> = "<serial_ipname>"
	YAML_SERIAL_CONSOLE_STDOUT:forcevariable:pn-<recipename> = "<serial_ipname>"
	in petalinuxbsp.conf file to specify the stdin/stdout."

config SUBSYSTEM_SERIAL_PS7_UART_0_SELECT
	bool "ps7_uart_0"

config SUBSYSTEM_SERIAL_PS7_UART_1_SELECT
	bool "ps7_uart_1"

config SUBSYSTEM_SERIAL_MANUAL_SELECT
	bool "manual"

endchoice

choice
	prompt "System stdin/stdout baudrate for ps7_uart_0"
	default SUBSYSTEM_SERIAL_PS7_UART_0_BAUDRATE_115200
	help
	Baudrate settings for serial Ip ps7_uart_0
	The Baudrate setting applies only for U-boot/Linux serial Ip

config SUBSYSTEM_SERIAL_PS7_UART_0_BAUDRATE_600
	bool "600"

config SUBSYSTEM_SERIAL_PS7_UART_0_BAUDRATE_9600
	bool "9600"

config SUBSYSTEM_SERIAL_PS7_UART_0_BAUDRATE_28800
	bool "28800"

config SUBSYSTEM_SERIAL_PS7_UART_0_BAUDRATE_115200
	bool "115200"

config SUBSYSTEM_SERIAL_PS7_UART_0_BAUDRATE_230400
	bool "230400"

config SUBSYSTEM_SERIAL_PS7_UART_0_BAUDRATE_460800
	bool "460800"

config SUBSYSTEM_SERIAL_PS7_UART_0_BAUDRATE_921600
	bool "921600"

endchoice

choice
	prompt "System stdin/stdout baudrate for ps7_uart_1"
	default SUBSYSTEM_SERIAL_PS7_UART_1_BAUDRATE_115200
	help
	Baudrate settings for serial Ip ps7_uart_1
	The Baudrate setting applies only for U-boot/Linux serial Ip

config SUBSYSTEM_SERIAL_PS7_UART_1_BAUDRATE_600
	bool "600"

config SUBSYSTEM_SERIAL_PS7_UART_1_BAUDRATE_9600
	bool "9600"

config SUBSYSTEM_SERIAL_PS7_UART_1_BAUDRATE_28800
	bool "28800"

config SUBSYSTEM_SERIAL_PS7_UART_1_BAUDRATE_115200
	bool "115200"

config SUBSYSTEM_SERIAL_PS7_UART_1_BAUDRATE_230400
	bool "230400"

config SUBSYSTEM_SERIAL_PS7_UART_1_BAUDRATE_460800
	bool "460800"

config SUBSYSTEM_SERIAL_PS7_UART_1_BAUDRATE_921600
	bool "921600"

endchoice

config SUBSYSTEM_SERIAL_FSBL_IP_NAME
	string
	default ps7_uart_0 if SUBSYSTEM_FSBL_SERIAL_PS7_UART_0_SELECT
	default ps7_uart_1 if SUBSYSTEM_FSBL_SERIAL_PS7_UART_1_SELECT

config SUBSYSTEM_SERIAL_IP_NAME
	string
	default ps7_uart_0 if SUBSYSTEM_SERIAL_PS7_UART_0_SELECT
	default ps7_uart_1 if SUBSYSTEM_SERIAL_PS7_UART_1_SELECT

endmenu

menu "Ethernet Settings"

choice
	prompt "Primary Ethernet"
	help
	Select a Ethernet used as primary Ethernet.
	The primary ethernet will be used for u-boot networking if u-boot is
	selected and will be used as eth0 in Linux.
	If your preferred primary ethernet is not on the list, please select"
	'manual'.

config SUBSYSTEM_ETHERNET_PS7_ETHERNET_0_SELECT
	bool "ps7_ethernet_0"

config SUBSYSTEM_ETHERNET_MANUAL_SELECT
	bool "manual"

endchoice

config SUBSYSTEM_ETHERNET_PS7_ETHERNET_0_MAC_AUTO
	bool "Randomise MAC address"
	default y if SUBSYSTEM_ARCH_MICROBLAZE
	default n
	depends on SUBSYSTEM_ETHERNET_PS7_ETHERNET_0_SELECT
	help
	randomise MAC address for the primary ethernet.

config SUBSYSTEM_ETHERNET_PS7_ETHERNET_0_MAC_PATTERN
	string "Template for randomised MAC address"
	default "00:0a:35:00:??:??"
	depends on SUBSYSTEM_ETHERNET_PS7_ETHERNET_0_SELECT && SUBSYSTEM_ETHERNET_PS7_ETHERNET_0_MAC_AUTO
	help
	Pattern for generating random MAC addresses - question mark
	characters will be replaced by random hex digits

config SUBSYSTEM_ETHERNET_PS7_ETHERNET_0_MAC
	string "Ethernet MAC address"
	default "ff:ff:ff:ff:ff:ff"
	depends on SUBSYSTEM_ETHERNET_PS7_ETHERNET_0_SELECT && !SUBSYSTEM_ETHERNET_PS7_ETHERNET_0_MAC_AUTO
	help
	Default mac set to ff:ff:ff:ff:ff:ff invalid mac address to read from EEPROM
	if you want change with desired value you can change, example: 00:0a:35:00:22:01

config SUBSYSTEM_ETHERNET_PS7_ETHERNET_0_USE_DHCP
	bool "Obtain IP address automatically"
	default y
	depends on SUBSYSTEM_ETHERNET_PS7_ETHERNET_0_SELECT
	help
	Set this option if you would like your SUBSYSTEM to use DHCP for
	obtaining an IP address.

config SUBSYSTEM_ETHERNET_PS7_ETHERNET_0_IP_ADDRESS
	string "Static IP address"
	default "192.168.0.10"
	depends on SUBSYSTEM_ETHERNET_PS7_ETHERNET_0_SELECT && !SUBSYSTEM_ETHERNET_PS7_ETHERNET_0_USE_DHCP
	help
	The IP address of your main network interface when static network
	address assignment is used.

config SUBSYSTEM_ETHERNET_PS7_ETHERNET_0_IP_NETMASK
	string "Static IP netmask"
	default "255.255.255.0"
	depends on SUBSYSTEM_ETHERNET_PS7_ETHERNET_0_SELECT && !SUBSYSTEM_ETHERNET_PS7_ETHERNET_0_USE_DHCP
	help
	Default netmask when static network address assignment is used.
	In case of systemd please specify netmask value like CIDR notation Eg: 24 instead of 255.255.255.0
	In case of sysvinit please specify netmask value like dot-decimal notation Eg: 255.255.255.0 instead of 24

config SUBSYSTEM_ETHERNET_PS7_ETHERNET_0_IP_GATEWAY
	string "Static IP gateway"
	default "192.168.0.1"
	depends on SUBSYSTEM_ETHERNET_PS7_ETHERNET_0_SELECT && !SUBSYSTEM_ETHERNET_PS7_ETHERNET_0_USE_DHCP
	help
	Default gateway when static network address assignment is used.

endmenu

menu "Flash Settings"

choice
	prompt "Primary Flash"
	help
	Select a Flash instance used as Primary Flash.
	PetaLinux auto config will apply the flash partition table settings
	to the primary flash.
	If you preferred flash is not on the list or you don't want PetaLinux
	to manage your flash partition, please select manual.

config SUBSYSTEM_FLASH_MANUAL_SELECT
	bool "manual"

endchoice

endmenu

menu "SD/SDIO Settings"

choice
	prompt "Primary SD/SDIO"
	help
	Select a SD instanced used as primary SD/SDIO.
	It allows you to select which SD controller is in the systems primary SD card interface.

config SUBSYSTEM_PRIMARY_SD_PS7_SD_0_SELECT
	bool "ps7_sd_0"

config SUBSYSTEM_PRIMARY_SD_MANUAL_SELECT
	bool "manual"

endchoice

endmenu

endif

endmenu
```
